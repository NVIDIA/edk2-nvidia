## Platform/NVIDIA/Server/Server.defconfig
```kconfig
# SPDX-FileCopyrightText: Copyright (c) 2023-2025 NVIDIA CORPORATION & AFFILIATES. All rights reserved.
#
# SPDX-License-Identifier: BSD-2-Clause-Patent
CONFIG_SOC_T24X=y
CONFIG_BUILD_DATACENTER=y
CONFIG_PLATFORM_GUID="9aef2e52-dead-4f63-b895-3a504a3e63c4"
CONFIG_FMP_SYSTEM_IMAGE_TYPE_ID="8655e5cf-297b-4213-84d5-b6817203a432"
```

## Platform/NVIDIA/ServerIgx/ServerIgx.defconfig
```kconfig
# SPDX-FileCopyrightText: Copyright (c) 2023-2025 NVIDIA CORPORATION & AFFILIATES. All rights reserved.
#
# SPDX-License-Identifier: BSD-2-Clause-Patent
CONFIG_SOC_T23X=y
CONFIG_BUILD_GENERAL=y
CONFIG_PLATFORM_GUID="0927650c-5959-4dfb-a40f-0f05a3cefbd6"
# CONFIG_SECURITY_DISABLE_PHYSICAL_PRESENCE_POST_SECUREBOOT is not set
CONFIG_ASPEED_2600_DISPLAY=y
CONFIG_IPMI_BMC=y
CONFIG_REDFISH=y
CONFIG_FMP_SYSTEM_IMAGE_TYPE_ID="db21ea33-80c8-4906-971a-49c0b3f7d1d0"
```

## Platform/NVIDIA/Tegra/DefConfigs/Jetson.defconfig
```kconfig
# SPDX-FileCopyrightText: Copyright (c) 2023-2025 NVIDIA CORPORATION & AFFILIATES. All rights reserved.
#
# SPDX-License-Identifier: BSD-2-Clause-Patent
CONFIG_SOC_T23X=y
CONFIG_BUILD_GENERAL=y
CONFIG_PLATFORM_GUID="49a79a15-8f69-4be7-a30c-a172f44abce7"
CONFIG_FMP_SYSTEM_IMAGE_TYPE_ID="bf0d4599-20d4-414e-b2c5-3595b1cda402"
```

## Platform/NVIDIA/Tegra/DefConfigs/t238_android.defconfig
```kconfig
# SPDX-FileCopyrightText: Copyright (c) 2023-2026 NVIDIA CORPORATION & AFFILIATES. All rights reserved.
#
# SPDX-License-Identifier: BSD-2-Clause-Patent
CONFIG_SOC_T23X=y
CONFIG_BUILD_ANDROID=y
CONFIG_PLATFORM_GUID="6ca3b63f-7ec5-48b6-bc2f-00d1b3456bab"
CONFIG_DEBUG_SERIAL_PORT_TCU_TX_MAILBOX=0x0A9C8000
CONFIG_FMP_SYSTEM_IMAGE_TYPE_ID="fb6b995a-2a94-4345-a41a-cc3a2aaeb1a9"
```

## Platform/NVIDIA/Tegra/DefConfigs/t23x_android.defconfig
```kconfig
# SPDX-FileCopyrightText: Copyright (c) 2023-2025 NVIDIA CORPORATION & AFFILIATES. All rights reserved.
#
# SPDX-License-Identifier: BSD-2-Clause-Patent
CONFIG_SOC_T23X=y
CONFIG_BUILD_ANDROID=y
CONFIG_PLATFORM_GUID="c193fdd8-7109-47a7-bf0e-02a94962d787"
CONFIG_LOGO_SCALED_SCREEN_RATIO=0
CONFIG_LOGO_SCALED_CENTER_Y=500
CONFIG_LOGO_IMPLEMENTER="Silicon/NVIDIA/Drivers/Logo/LogoMultipleGray.inf"
CONFIG_FMP_SYSTEM_IMAGE_TYPE_ID="bee27e77-d09c-47fe-a87d-f61a34b7e0b0"
```

## Platform/NVIDIA/Tegra/DefConfigs/t23x_simple_emmc.defconfig
```kconfig
# SPDX-FileCopyrightText: Copyright (c) 2023-2025 NVIDIA CORPORATION & AFFILIATES. All rights reserved.
#
# SPDX-License-Identifier: BSD-2-Clause-Patent
CONFIG_SOC_T23X=y
CONFIG_BUILD_SIMPLE=y
CONFIG_PLATFORM_GUID="ccb0c2f9-27c6-4a98-ac19-fe9429b59e7d"
CONFIG_EMMC=y
CONFIG_BOOT_DEFAULT_TIMEOUT=0
CONFIG_FMP_SYSTEM_IMAGE_TYPE_ID="5cdb9398-9a1f-44a4-986b-bbd034590537"
```

## Platform/NVIDIA/Tegra/DefConfigs/t23x_simple_pcie.defconfig
```kconfig
# SPDX-FileCopyrightText: Copyright (c) 2023-2025 NVIDIA CORPORATION & AFFILIATES. All rights reserved.
#
# SPDX-License-Identifier: BSD-2-Clause-Patent
CONFIG_SOC_T23X=y
CONFIG_BUILD_SIMPLE=y
CONFIG_PLATFORM_GUID="3c88c11a-8d99-4a18-acbd-4b76e430e20d"
CONFIG_PCIE=y
CONFIG_NVME=y
CONFIG_BOOT_DEFAULT_TIMEOUT=0
CONFIG_FMP_SYSTEM_IMAGE_TYPE_ID="aeb40576-5d97-4d60-a138-93788792bf34"
```

## Platform/NVIDIA/Tegra/DefConfigs/t268_general.defconfig
```kconfig
# SPDX-FileCopyrightText: Copyright (c) 2023-2026 NVIDIA CORPORATION & AFFILIATES. All rights reserved.
#
# SPDX-License-Identifier: BSD-2-Clause-Patent
CONFIG_SOC_T26X=y
CONFIG_SOC_T26X_IS_T268=y
CONFIG_BUILD_GENERAL=y
CONFIG_PLATFORM_GUID="d031d72d-9cce-4fd8-9175-dbd65abf2a84"
CONFIG_FMP_SYSTEM_IMAGE_TYPE_ID="9a3c33fc-204f-4888-a008-4dec00eb79a0"
```

## Platform/NVIDIA/Tegra/DefConfigs/t268_minimal.defconfig
```kconfig
# SPDX-FileCopyrightText: Copyright (c) 2023-2026 NVIDIA CORPORATION & AFFILIATES. All rights reserved.
#
# SPDX-License-Identifier: BSD-2-Clause-Patent
CONFIG_SOC_T26X=y
CONFIG_SOC_T26X_IS_T268=y
CONFIG_BUILD_MINIMAL=y
CONFIG_PLATFORM_GUID="97499e71-6305-44fe-bfe0-9a335be4dabd"
CONFIG_PCIE=y
CONFIG_NVME=y
CONFIG_UFS=y
```

## Platform/NVIDIA/Tegra/DefConfigs/t268_simple_pcie.defconfig
```kconfig
# SPDX-FileCopyrightText: Copyright (c) 2023-2026 NVIDIA CORPORATION & AFFILIATES. All rights reserved.
#
# SPDX-License-Identifier: BSD-2-Clause-Patent
CONFIG_SOC_T26X=y
CONFIG_SOC_T26X_IS_T268=y
CONFIG_BUILD_SIMPLE=y
CONFIG_PLATFORM_GUID="e3ed4aa3-6727-4035-8bbc-3098ad600b34"
CONFIG_PCIE=y
CONFIG_NVME=y
CONFIG_BOOT_DEFAULT_TIMEOUT=0
CONFIG_FMP_SYSTEM_IMAGE_TYPE_ID="1915e8b4-d382-44c9-85eb-b18bfee35458"
```

## Platform/NVIDIA/Tegra/DefConfigs/t268_simple_ufs.defconfig
```kconfig
# SPDX-FileCopyrightText: Copyright (c) 2023-2026 NVIDIA CORPORATION & AFFILIATES. All rights reserved.
#
# SPDX-License-Identifier: BSD-2-Clause-Patent
CONFIG_SOC_T26X=y
CONFIG_SOC_T26X_IS_T268=y
CONFIG_BUILD_SIMPLE=y
CONFIG_PLATFORM_GUID="367a23f8-fb70-43b8-9b6d-59ac4d5fdc3d"
CONFIG_UFS=y
CONFIG_BOOT_DEFAULT_TIMEOUT=0
CONFIG_FMP_SYSTEM_IMAGE_TYPE_ID="78976292-c151-4310-848f-ecbaf94834a7"
```

## Platform/NVIDIA/Tegra/DefConfigs/t26x_android.defconfig
```kconfig
# SPDX-FileCopyrightText: Copyright (c) 2023-2025 NVIDIA CORPORATION & AFFILIATES. All rights reserved.
#
# SPDX-License-Identifier: BSD-2-Clause-Patent
CONFIG_SOC_T26X=y
CONFIG_BUILD_ANDROID=y
CONFIG_FMP_SYSTEM_IMAGE_TYPE_ID="3c834404-d2d7-4912-8c1c-6e850b5f2824"
```

## Platform/NVIDIA/Tegra/DefConfigs/t26x_general_igx.defconfig
```kconfig
# SPDX-FileCopyrightText: Copyright (c) 2023-2026 NVIDIA CORPORATION & AFFILIATES. All rights reserved.
#
# SPDX-License-Identifier: BSD-2-Clause-Patent
CONFIG_SOC_T26X=y
CONFIG_BUILD_GENERAL=y
CONFIG_PLATFORM_GUID="09af6066-2719-4db1-9dc8-424ca8251b19"
# CONFIG_SECURITY_DISABLE_PHYSICAL_PRESENCE_POST_SECUREBOOT is not set
CONFIG_ASPEED_2600_DISPLAY=y
CONFIG_IPMI_BMC=y
CONFIG_REDFISH=y
CONFIG_REDFISH_HTTP_BOOT_CONFIG=y
CONFIG_FMP_SYSTEM_IMAGE_TYPE_ID="cbf069ce-116a-4215-9951-66565d283089"
```

## Platform/NVIDIA/Tegra/DefConfigs/t26x_simple_pcie.defconfig
```kconfig
# SPDX-FileCopyrightText: Copyright (c) 2023-2025 NVIDIA CORPORATION & AFFILIATES. All rights reserved.
#
# SPDX-License-Identifier: BSD-2-Clause-Patent
CONFIG_SOC_T26X=y
CONFIG_BUILD_SIMPLE=y
CONFIG_PLATFORM_GUID="2dc55e53-938a-4e65-80c1-7c2f18c0a620"
CONFIG_PCIE=y
CONFIG_NVME=y
CONFIG_BOOT_DEFAULT_TIMEOUT=0
CONFIG_FMP_SYSTEM_IMAGE_TYPE_ID="fc63b2f1-314e-4155-94dc-c47b3b94fda5"
```

## Platform/NVIDIA/Tegra/DefConfigs/t26x_simple_ufs.defconfig
```kconfig
# SPDX-FileCopyrightText: Copyright (c) 2023-2025 NVIDIA CORPORATION & AFFILIATES. All rights reserved.
#
# SPDX-License-Identifier: BSD-2-Clause-Patent
CONFIG_SOC_T26X=y
CONFIG_BUILD_SIMPLE=y
CONFIG_PLATFORM_GUID="f6c2d20a-1e0f-417a-938a-542cf882697a"
CONFIG_UFS=y
CONFIG_BOOT_DEFAULT_TIMEOUT=0
CONFIG_FMP_SYSTEM_IMAGE_TYPE_ID="2b7f8709-aa4c-4c6f-9671-9e97513f480c"
```

## Silicon/NVIDIA/Kconfig
```kconfig
# @file
#
#  Config file for NVIDIA UEFI builds
#
#  SPDX-FileCopyrightText: Copyright (c) 2023 NVIDIA CORPORATION & AFFILIATES. All rights reserved.
#
#  SPDX-License-Identifier: BSD-2-Clause-Patent
#
#
menu "Boot Options"
  config BOOT_QUICK_BOOT
  bool "Quick boot support"
  default n
  help
    UEFI quick boot supported

  config BOOT_DEFAULT_TIMEOUT
  int "Boot timeout"
  depends on SINGLE_BOOT_NONE
  default 5
  help
    UEFI boot timeout

  config BOOT_NATIVE_ANDROID_PARTITION_SUPPORT
  bool "Android partition support"
  default n
  help
    Support for native android boot partition, without EFI system partition

  config BOOT_NVIDIA_CUSTOM_OPTION_DESCRIPTION
  bool "NVIDIA Custom boot order description"
  default n
  help
    Support for nvidia specific overrides for boot options

  choice SINGLE_BOOT_SUPPORT
    prompt "Single boot built-in boot application support"

    config SINGLE_BOOT_NONE
    bool "Not supported"
    help
      Normal boot operation

    config SINGLE_BOOT_DEADLOOP_APP
    bool "Deadloop application"
    select BOOT_UI_MENU_DISABLED
    help
       Launch application that deadloops

    config SINGLE_BOOT_L4T_LAUNCHER
    bool "L4T Launcher"
    select BOOT_UI_MENU_DISABLED
    help
      L4T Launcher default

  endchoice

  config BOOT_UI_MENU_DISABLED
  depends on SINGLE_BOOT_DEADLOOP_APP || SINGLE_BOOT_L4T_LAUNCHER
  bool "UI Menu Application disabled"

endmenu
menu	"Watchdog settings"

  config	BOOT_WATCHDOG_TIMEOUT
  int	"Boot watchdog timeout"
  default	5
  help
    Time in minutes to reboot system before boot options are processed

  config	ARM_WATCHDOG
    bool "Use ARM watchdog instead of timer"
    default	y
    help
      Use the ARM generic watchdog timer driver
endmenu
```
