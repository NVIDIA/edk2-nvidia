## Platform/NVIDIA/Android/Android.defconfig
```kconfig
# SPDX-FileCopyrightText: Copyright (c) 2023-2024 NVIDIA CORPORATION & AFFILIATES. All rights reserved.
#
# SPDX-License-Identifier: BSD-2-Clause-Patent
CONFIG_SOC_ORIN=y
CONFIG_SECURITY_TPM_FIRMWARE=y
CONFIG_SECURITY_UEFI_MENU_USER_AUTH=y
CONFIG_SECURITY_MM_OPTEE=y
CONFIG_SECURITY_PHYSICAL_PRESENCE=y
CONFIG_SECURITY_DISABLE_PHYSICAL_PRESENCE_POST_SECUREBOOT=y
CONFIG_VARIABLE_NON_SECURE_SUPPORTED=y
CONFIG_EMMC=y
CONFIG_SDCARD=y
CONFIG_UFS=y
CONFIG_SATA=y
CONFIG_EHCI=y
CONFIG_NVIDIA_DISPLAY=y
CONFIG_SERIAL_PORT_CONSOLE_TEGRA=y
CONFIG_DEVICETREE=y
CONFIG_RCM_BOOT=y
CONFIG_BOOT_QUICK_BOOT=y
CONFIG_BOOT_QUICK_BOOT_ENABLED=y
CONFIG_BOOT_NATIVE_ANDROID_PARTITION_SUPPORT=y
CONFIG_BOOT_ANDROID_FASTBOOT=y
CONFIG_BOOT_NVIDIA_CUSTOM_OPTION_DESCRIPTION=y
CONFIG_L4T=y
CONFIG_FIRMWARE_MANAGEMENT_FMP_ESRT_GUID="7C374309-1649-4682-8BEE-04F3A8399414"
# CONFIG_ARM_WATCHDOG is not set
CONFIG_NETWORKING_DEVICE_REALTEK=y
CONFIG_NETWORKING_DEVICE_ASIX=y
CONFIG_FS_EXT4=y
```

## Platform/NVIDIA/Jetson/Jetson.defconfig
```kconfig
# SPDX-FileCopyrightText: Copyright (c) 2023-2025 NVIDIA CORPORATION & AFFILIATES. All rights reserved.
#
# SPDX-License-Identifier: BSD-2-Clause-Patent
CONFIG_SOC_T23X=y
CONFIG_BUILD_GENERAL=y
CONFIG_FIRMWARE_MANAGEMENT_FMP_ESRT_GUID="7C374309-1649-4682-8BEE-04F3A8399414"
CONFIG_PLATFORM_GUID="49a79a15-8f69-4be7-a30c-a172f44abce7"
```

## Platform/NVIDIA/JetsonFF-A/JetsonFF-A.defconfig
```kconfig
# SPDX-FileCopyrightText: Copyright (c) 2023-2025 NVIDIA CORPORATION & AFFILIATES. All rights reserved.
#
# SPDX-License-Identifier: BSD-2-Clause-Patent
CONFIG_SOC_T26X=y
CONFIG_BUILD_GENERAL=y
CONFIG_PLATFORM_GUID="b175f7b7-0cb0-446e-b338-0e0d0f688de8"
CONFIG_IPMI_BMC=y
CONFIG_FMP_SYSTEM_IMAGE_TYPE_ID="3c834404-d2d7-4912-8c1c-6e850b5f2824"
```

## Platform/NVIDIA/JetsonFF-AMinimal/JetsonFF-AMinimal.defconfig
```kconfig
# SPDX-FileCopyrightText: Copyright (c) 2023-2025 NVIDIA CORPORATION & AFFILIATES. All rights reserved.
#
# SPDX-License-Identifier: BSD-2-Clause-Patent
CONFIG_SOC_T26X=y
CONFIG_BUILD_EMBEDDED=y
CONFIG_PLATFORM_GUID="df0e10d8-aeac-451d-a2d7-ef1e58dc59d9"
CONFIG_PCIE=y
CONFIG_NVME=y
CONFIG_UFS=y
```

## Platform/NVIDIA/JetsonMinimal/Jetson.defconfig
```kconfig
# SPDX-FileCopyrightText: Copyright (c) 2023-2025 NVIDIA CORPORATION & AFFILIATES. All rights reserved.
#
# SPDX-License-Identifier: BSD-2-Clause-Patent
CONFIG_SOC_T23X=y
CONFIG_BUILD_EMBEDDED=y
CONFIG_PLATFORM_GUID="f98bcf32-fd20-4ba9-ada4-e0406947ca3c"
```
