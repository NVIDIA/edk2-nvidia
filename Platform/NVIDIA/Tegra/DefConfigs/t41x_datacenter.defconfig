## Platform/NVIDIA/Tegra/DefConfigs/t41x_datacenter.defconfig
```kconfig
# SPDX-FileCopyrightText: Copyright (c) 2023-2026 NVIDIA CORPORATION & AFFILIATES. All rights reserved.
#
# SPDX-License-Identifier: BSD-2-Clause-Patent
CONFIG_SOC_T41X=y
CONFIG_BUILD_DATACENTER=y
CONFIG_PLATFORM_GUID="45b1b77f-6011-4f6a-a4d8-76b1ecf6d789"
# CONFIG_SECURITY_UEFI_MENU_USER_AUTH is not set
CONFIG_BOOT_FDT_SUPPORT=y
CONFIG_FIRMWARE_MANAGEMENT=y
CONFIG_FMP_SYSTEM_IMAGE_TYPE_ID="70d792a2-10bb-4567-a1c1-51dc0064f46d"
```
