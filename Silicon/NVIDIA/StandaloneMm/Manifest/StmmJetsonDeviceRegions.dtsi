/*
 *
 * Device Regions for the StandaloneMmJetson SP.
 *
 * SPDX-FileCopyrightText: Copyright (c) 2025 NVIDIA CORPORATION & AFFILIATES. All rights reserved.
 * SPDX-License-Identifier: BSD-3-Clause
 *
 *
 */

tegra-misc {
  base-address = < 0x00000000 0x00100000 >;
  pages-count  = < 4 >;
  attributes   = < 0x3 >;                   // read-write
};

tegra-scratch {
  base-address = < 0x00000000 0x00C390000 >;
  pages-count  = < 4 >;
  attributes   = < 0x3 >;                   // read-write
};

qspi0-socket0 {
  base-address = < 0x00000081 0x0c5b0000 >;
  pages-count  = < 16 >;
  attributes   = < 0x3 >;                   // read-write
};

th500-gpio-socket0 {
  base-address = < 0x00000000 0x2210000 >;
  pages-count  = < 16 >;
  attributes   = < 0x3 >;                   // read-write
};
