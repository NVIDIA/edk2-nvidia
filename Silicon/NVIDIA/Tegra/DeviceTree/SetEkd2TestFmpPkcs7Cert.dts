/** @file
*  Set the EKD2 TEST FMP PKCS7 Certificate.
*
*  SPDX-FileCopyrightText: Copyright (c) 2025 NVIDIA CORPORATION & AFFILIATES. All rights reserved.
*
*  SPDX-License-Identifier: BSD-2-Clause-Patent
*
**/

/dts-v1/;
/plugin/;

/ {
	overlay-name = "Set **EDK2 TEST** FMP PKCS7 Certificate - DO NOT USE IN PRODUCTION";

	fragment@0 {
		target-path = "/";
		board_config {
			sw-modules = "uefi";
		};

		__overlay__ {
			firmware {
				uefi {
					/*
					** To create new certificates: https://github.com/tianocore/tianocore.github.io/wiki/Capsule-Based-System-Firmware-Update-Generate-Keys
					**
				    ** This is EDK TEST Certificate from
					** BaseTools/Source/Python/Pkcs7Sign/TestRoot.cer.gFmpDevicePkgTokenSpaceGuid.PcdFmpDevicePkcs7CertBufferXdr.inc
					*/
					fmp-pkcs7-cert-buffer-xdr = [
						00 00 03 F0 30 82 03 EC 30 82 02 D4 A0 03 02 01 02 02 09 00 C0 91 C5 E2 B7 66 C0 F8 30 0D 06 09
						2A 86 48 86 F7 0D 01 01 0B 05 00 30 81 82 31 0B 30 09 06 03 55 04 06 13 02 43 4E 31 0B 30 09 06
						03 55 04 08 0C 02 53 48 31 0B 30 09 06 03 55 04 07 0C 02 53 48 31 12 30 10 06 03 55 04 0A 0C 09
						54 69 61 6E 6F 43 6F 72 65 31 0E 30 0C 06 03 55 04 0B 0C 05 45 44 4B 49 49 31 11 30 0F 06 03 55
						04 03 0C 08 54 65 73 74 52 6F 6F 74 31 22 30 20 06 09 2A 86 48 86 F7 0D 01 09 01 16 13 65 64 6B
						69 69 40 74 69 61 6E 6F 63 6F 72 65 2E 6F 72 67 30 1E 17 0D 31 37 30 34 31 30 30 38 32 37 34 30
						5A 17 0D 31 37 30 35 31 30 30 38 32 37 34 30 5A 30 81 82 31 0B 30 09 06 03 55 04 06 13 02 43 4E
						31 0B 30 09 06 03 55 04 08 0C 02 53 48 31 0B 30 09 06 03 55 04 07 0C 02 53 48 31 12 30 10 06 03
						55 04 0A 0C 09 54 69 61 6E 6F 43 6F 72 65 31 0E 30 0C 06 03 55 04 0B 0C 05 45 44 4B 49 49 31 11
						30 0F 06 03 55 04 03 0C 08 54 65 73 74 52 6F 6F 74 31 22 30 20 06 09 2A 86 48 86 F7 0D 01 09 01
						16 13 65 64 6B 69 69 40 74 69 61 6E 6F 63 6F 72 65 2E 6F 72 67 30 82 01 22 30 0D 06 09 2A 86 48
						86 F7 0D 01 01 01 05 00 03 82 01 0F 00 30 82 01 0A 02 82 01 01 00 B9 29 29 6C 60 0C D7 23 F6 7D
						EE F0 62 FF D9 C9 AA 55 8C 81 95 56 3F B7 56 53 B0 C2 82 12 C5 3B 75 23 B9 4D D6 C4 55 73 F3 AA
						95 A8 1B F3 93 7E 9E 40 E4 1D 22 9C 93 07 0B D7 AA 5B D7 E4 1A 21 84 D7 63 59 03 50 1F F5 14 55
						93 91 9B F5 52 B0 BF 0E 5C 68 3B 59 52 98 96 56 E1 AB C4 43 BB 05 57 78 45 01 9F 58 15 53 0E 11
						94 2F 0E F1 A6 19 A2 6E 86 39 2B 33 8D C7 C5 EB EE 1E 33 D3 32 94 C1 59 C4 0C 97 0B 12 48 5F 33
						F6 60 74 7D 57 C2 13 2D 7D A9 87 A3 35 EA 91 83 3F 67 7A 92 1F 01 53 9F 62 5F 99 12 FD 73 1B 2D
						9E 2B 6C 34 49 AF 4F 07 8F C0 E9 6B 9E 5F 79 35 DA 2A 5C 88 EE F6 48 61 DA 96 E3 48 46 A0 94 1C
						9D F6 5C 87 0E EF 74 09 91 0D 3D 5A E7 C5 4C 8A 7A AC A1 85 B6 67 44 17 55 52 3A E8 11 4D 58 A2
						93 00 62 EA 7B 80 ED CF BD DF 75 80 4B B9 65 63 AD 0B 4D 74 FA 59 02 03 01 00 01 A3 63 30 61 30
						1D 06 03 55 1D 0E 04 16 04 14 16 AA D6 8E 1B 2D 43 F3 2D B0 24 AD 36 65 3F B2 FA B1 2C ED 30 1F
						06 03 55 1D 23 04 18 30 16 80 14 16 AA D6 8E 1B 2D 43 F3 2D B0 24 AD 36 65 3F B2 FA B1 2C ED 30
						0F 06 03 55 1D 13 01 01 FF 04 05 30 03 01 01 FF 30 0E 06 03 55 1D 0F 01 01 FF 04 04 03 02 01 86
						30 0D 06 09 2A 86 48 86 F7 0D 01 01 0B 05 00 03 82 01 01 00 95 DE DF A4 14 DB 92 22 78 1A BD 31
						9D 1E D7 2F 0A 10 11 5D 74 61 E8 30 C4 F3 15 E9 30 54 F4 BB 0C 04 78 13 5D 2C DD 8C 92 90 D1 9C
						D0 D0 18 A3 A3 FC 8C 28 5A D4 91 4D 08 C3 F6 1A C8 DD A6 08 58 E2 15 95 FB 2D 2D 8A B1 30 80 BD
						9A B6 E1 2C 20 3E DD C4 C7 55 65 CF 28 17 F4 EE DA BE 77 70 D5 52 D6 15 7A FB AD AF FD D5 45 90
						5A E6 31 42 D7 84 B3 49 56 6A D3 47 F3 BF 68 60 8B 0F E2 AF F4 E3 EC 12 B9 E2 3A 16 11 4E 4D 73
						79 AF 47 85 4C 76 26 9E 8B 32 C0 8E C2 DC 27 A6 EF AC 93 9E A1 5E CF 34 45 E0 2A C7 9D 4D D7 D7
						37 72 97 F8 58 F9 B6 35 48 F1 D1 0A 72 7F FD 4D 7C E9 CC D8 48 1B 49 52 53 DE 51 01 53 35 BC 90
						CD 8C 8A CC 43 20 A7 45 FF 2B 55 B0 8B 2D FF 55 15 4B 84 D0 C3 D3 90 9C 94 4B 55 D5 62 EA 22 AB
						62 68 DD 53 C6 DC A5 DD 9A 2D 8E 79 7C 2E 9C E4 66 80 8C 1D];
				};
			};
		};
	};
};
