/** @file
*  Set the FMP Image Type ID GUID for t264 platform.
*
*  SPDX-FileCopyrightText: Copyright (c) 2025, NVIDIA CORPORATION & AFFILIATES. All rights reserved.
*
*  SPDX-License-Identifier: BSD-2-Clause-Patent
*
**/

/dts-v1/;
/plugin/;

/ {
	overlay-name = "Set T264 FMP Image Type ID. This is an NVIDIA internal GUID not for production.";

	fragment@0 {
		target-path = "/";
		board_config {
			sw-modules = "uefi";
		};

		__overlay__ {
			firmware {
				uefi {
					/* Set your platform-specific GUID */
					fmp-image-type-id-guid = "3c834404-d2d7-4912-8c1c-6e850b5f2824";
				};
			};
		};
	};
};
